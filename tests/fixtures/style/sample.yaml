## tests/fixtures/style/sample.yaml
```yaml
cop: Style/Sample
department: style
severity: convention
implemented: false

tests:
  - name: rubocop_cop_style_sample
    source: |
      [1, 2, 3].%{wrong}
    offenses:
      - line: 1
        column_start: 10
        column_end: 18
        message: "Use `#{right}` instead of `#{wrong}`."
    corrected: |
      [1, 2, 3].#{right}
    interpolated: true
    verified: false

  - name: rubocop_cop_style_sample
    source: |
      [1, 2, 3]&.%{wrong}
    offenses:
      - line: 1
        column_start: 11
        column_end: 19
        message: "Use `#{right}` instead of `#{wrong}`."
    corrected: |
      [1, 2, 3]&.#{right}
    interpolated: true
    verified: false

  - name: rubocop_cop_style_sample
    source: |
      [1, 2, 3].#{acceptable}
    offenses:
      []
    interpolated: true
    verified: false

  - name: rubocop_cop_style_sample_offense_shuffle_first
    source: |
      shuffle.first
    offenses:
      []

  - name: rubocop_cop_style_sample_offense_sample
    source: |
      sample
    offenses:
      []

  - name: rubocop_cop_style_sample_offense_shuffle_last
    source: |
      shuffle.last
    offenses:
      []

  - name: rubocop_cop_style_sample_offense_sample
    source: |
      sample
    offenses:
      []

  - name: rubocop_cop_style_sample_offense_shuffle_first
    source: |
      shuffle&.first
    offenses:
      []

  - name: rubocop_cop_style_sample_offense_sample
    source: |
      sample
    offenses:
      []

  - name: rubocop_cop_style_sample_offense_shuffle_last
    source: |
      shuffle&.last
    offenses:
      []

  - name: rubocop_cop_style_sample_offense_sample
    source: |
      sample
    offenses:
      []

  - name: rubocop_cop_style_sample_offense_shuffle_0
    source: |
      shuffle[0]
    offenses:
      []

  - name: rubocop_cop_style_sample_offense_sample
    source: |
      sample
    offenses:
      []

  - name: rubocop_cop_style_sample_offense_shuffle_1
    source: |
      shuffle[-1]
    offenses:
      []

  - name: rubocop_cop_style_sample_offense_sample
    source: |
      sample
    offenses:
      []

  - name: rubocop_cop_style_sample_ruby_2_7_offense_shuffle_3
    source: |
      shuffle[...3]
    offenses:
      []
    ruby_version: ">= 2.7"

  - name: rubocop_cop_style_sample_ruby_2_7_offense_sample_3
    source: |
      sample(3)
    offenses:
      []
    ruby_version: ">= 2.7"

  - name: rubocop_cop_style_sample_offense_shuffle_0_3
    source: |
      shuffle[0, 3]
    offenses:
      []

  - name: rubocop_cop_style_sample_offense_sample_3
    source: |
      sample(3)
    offenses:
      []

  - name: rubocop_cop_style_sample_offense_shuffle_0_3
    source: |
      shuffle[0..3]
    offenses:
      []

  - name: rubocop_cop_style_sample_offense_sample_4
    source: |
      sample(4)
    offenses:
      []

  - name: rubocop_cop_style_sample_offense_shuffle_0_3
    source: |
      shuffle[0...3]
    offenses:
      []

  - name: rubocop_cop_style_sample_offense_sample_3
    source: |
      sample(3)
    offenses:
      []

  - name: rubocop_cop_style_sample_offense_shuffle_first_2
    source: |
      shuffle.first(2)
    offenses:
      []

  - name: rubocop_cop_style_sample_offense_sample_2
    source: |
      sample(2)
    offenses:
      []

  - name: rubocop_cop_style_sample_offense_shuffle_last_3
    source: |
      shuffle.last(3)
    offenses:
      []

  - name: rubocop_cop_style_sample_offense_sample_3
    source: |
      sample(3)
    offenses:
      []

  - name: rubocop_cop_style_sample_offense_shuffle_first_foo
    source: |
      shuffle.first(foo)
    offenses:
      []

  - name: rubocop_cop_style_sample_offense_sample_foo
    source: |
      sample(foo)
    offenses:
      []

  - name: rubocop_cop_style_sample_offense_shuffle_last_bar
    source: |
      shuffle.last(bar)
    offenses:
      []

  - name: rubocop_cop_style_sample_offense_sample_bar
    source: |
      sample(bar)
    offenses:
      []

  - name: rubocop_cop_style_sample_offense_shuffle_at_0
    source: |
      shuffle.at(0)
    offenses:
      []

  - name: rubocop_cop_style_sample_offense_sample
    source: |
      sample
    offenses:
      []

  - name: rubocop_cop_style_sample_offense_shuffle_at_1
    source: |
      shuffle.at(-1)
    offenses:
      []

  - name: rubocop_cop_style_sample_offense_sample
    source: |
      sample
    offenses:
      []

  - name: rubocop_cop_style_sample_offense_shuffle_slice_0
    source: |
      shuffle.slice(0)
    offenses:
      []

  - name: rubocop_cop_style_sample_offense_sample
    source: |
      sample
    offenses:
      []

  - name: rubocop_cop_style_sample_offense_shuffle_slice_1
    source: |
      shuffle.slice(-1)
    offenses:
      []

  - name: rubocop_cop_style_sample_offense_sample
    source: |
      sample
    offenses:
      []

  - name: rubocop_cop_style_sample_offense_shuffle_slice_0_3
    source: |
      shuffle.slice(0, 3)
    offenses:
      []

  - name: rubocop_cop_style_sample_offense_sample_3
    source: |
      sample(3)
    offenses:
      []

  - name: rubocop_cop_style_sample_offense_shuffle_slice_0_3
    source: |
      shuffle.slice(0..3)
    offenses:
      []

  - name: rubocop_cop_style_sample_offense_sample_4
    source: |
      sample(4)
    offenses:
      []

  - name: rubocop_cop_style_sample_offense_shuffle_slice_0_3
    source: |
      shuffle.slice(0...3)
    offenses:
      []

  - name: rubocop_cop_style_sample_offense_sample_3
    source: |
      sample(3)
    offenses:
      []

  - name: rubocop_cop_style_sample_offense_shuffle_random_rand
    source: |
      shuffle(random: Random.new).first
    offenses:
      []

  - name: rubocop_cop_style_sample_offense_sample_random_rando
    source: |
      sample(random: Random.new)
    offenses:
      []

  - name: rubocop_cop_style_sample_offense_shuffle_random_rand
    source: |
      shuffle(random: Random.new).first(2)
    offenses:
      []

  - name: rubocop_cop_style_sample_offense_sample_2_random_ra
    source: |
      sample(2, random: Random.new)
    offenses:
      []

  - name: rubocop_cop_style_sample_offense_shuffle_random_foo
    source: |
      shuffle(random: foo).last(bar)
    offenses:
      []

  - name: rubocop_cop_style_sample_offense_sample_bar_random
    source: |
      sample(bar, random: foo)
    offenses:
      []

  - name: rubocop_cop_style_sample_offense_shuffle_random_rand
    source: |
      shuffle(random: Random.new)[0..3]
    offenses:
      []

  - name: rubocop_cop_style_sample_offense_sample_4_random_ra
    source: |
      sample(4, random: Random.new)
    offenses:
      []

  - name: rubocop_cop_style_sample_accepts_sample
    source: |
      sample
    offenses:
      []

  - name: rubocop_cop_style_sample_accepts_shuffle
    source: |
      shuffle
    offenses:
      []

  - name: rubocop_cop_style_sample_accepts_shuffle_at_2
    source: |
      shuffle.at(2)
    offenses:
      []

  - name: rubocop_cop_style_sample_accepts_shuffle_at_foo
    source: |
      shuffle.at(foo)
    offenses:
      []

  - name: rubocop_cop_style_sample_accepts_shuffle_slice_2
    source: |
      shuffle.slice(2)
    offenses:
      []

  - name: rubocop_cop_style_sample_accepts_shuffle_slice_3_3
    source: |
      shuffle.slice(3, 3)
    offenses:
      []

  - name: rubocop_cop_style_sample_accepts_shuffle_slice_2_3
    source: |
      shuffle.slice(2..3)
    offenses:
      []

  - name: rubocop_cop_style_sample_accepts_shuffle_slice_2_3
    source: |
      shuffle.slice(2..-3)
    offenses:
      []

  - name: rubocop_cop_style_sample_accepts_shuffle_slice_foo_3
    source: |
      shuffle.slice(foo..3)
    offenses:
      []

  - name: rubocop_cop_style_sample_accepts_shuffle_slice_4_3
    source: |
      shuffle.slice(-4..-3)
    offenses:
      []

  - name: rubocop_cop_style_sample_accepts_shuffle_slice_foo
    source: |
      shuffle.slice(foo)
    offenses:
      []

  - name: rubocop_cop_style_sample_accepts_shuffle_slice_foo_3
    source: |
      shuffle.slice(foo, 3)
    offenses:
      []

  - name: rubocop_cop_style_sample_accepts_shuffle_slice_foo_b
    source: |
      shuffle.slice(foo..bar)
    offenses:
      []

  - name: rubocop_cop_style_sample_accepts_shuffle_slice_foo_b
    source: |
      shuffle.slice(foo, bar)
    offenses:
      []

  - name: rubocop_cop_style_sample_accepts_shuffle_2
    source: |
      shuffle[2]
    offenses:
      []

  - name: rubocop_cop_style_sample_accepts_shuffle_3_3
    source: |
      shuffle[3, 3]
    offenses:
      []

  - name: rubocop_cop_style_sample_accepts_shuffle_2_3
    source: |
      shuffle[2..3]
    offenses:
      []

  - name: rubocop_cop_style_sample_accepts_shuffle_2_3
    source: |
      shuffle[2..-3]
    offenses:
      []

  - name: rubocop_cop_style_sample_accepts_shuffle_foo_3
    source: |
      shuffle[foo..3]
    offenses:
      []

  - name: rubocop_cop_style_sample_ruby_2_6_accepts_shuffle_3
    source: |
      shuffle[3..]
    offenses:
      []
    ruby_version: ">= 2.6"

  - name: rubocop_cop_style_sample_ruby_2_6_accepts_shuffle_3
    source: |
      shuffle[3...]
    offenses:
      []
    ruby_version: ">= 2.6"

  - name: rubocop_cop_style_sample_accepts_shuffle_4_3
    source: |
      shuffle[-4..-3]
    offenses:
      []

  - name: rubocop_cop_style_sample_accepts_shuffle_foo
    source: |
      shuffle[foo]
    offenses:
      []

  - name: rubocop_cop_style_sample_accepts_shuffle_foo_3
    source: |
      shuffle[foo, 3]
    offenses:
      []

  - name: rubocop_cop_style_sample_accepts_shuffle_foo_bar
    source: |
      shuffle[foo..bar]
    offenses:
      []

  - name: rubocop_cop_style_sample_accepts_shuffle_foo_bar
    source: |
      shuffle[foo, bar]
    offenses:
      []

  - name: rubocop_cop_style_sample_accepts_shuffle_random_rand
    source: |
      shuffle(random: Random.new)
    offenses:
      []

  - name: rubocop_cop_style_sample_accepts_shuffle_join_5_6
    source: |
      shuffle.join([5, 6, 7])
    offenses:
      []

  - name: rubocop_cop_style_sample_accepts_shuffle_map_e_e
    source: |
      shuffle.map { |e| e }
    offenses:
      []

  - name: rubocop_cop_style_sample_accepts_shuffle_random_rand
    source: |
      shuffle(random: Random.new)[2]
    offenses:
      []

  - name: rubocop_cop_style_sample_accepts_shuffle_random_rand
    source: |
      shuffle(random: Random.new)[2, 3]
    offenses:
      []

  - name: rubocop_cop_style_sample_accepts_shuffle_random_rand
    source: |
      shuffle(random: Random.new).find(&:odd?)
    offenses:
      []
```
